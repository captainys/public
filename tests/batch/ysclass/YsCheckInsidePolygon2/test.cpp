/* ////////////////////////////////////////////////////////////

File Name: test.cpp
Copyright (c) 2017 Soji Yamakawa.  All rights reserved.
http://www.ysflight.com

Redistribution and use in source and binary forms, with or without modification, 
are permitted provided that the following conditions are met:

1. Redistributions of source code must retain the above copyright notice, 
   this list of conditions and the following disclaimer.

2. Redistributions in binary form must reproduce the above copyright notice, 
   this list of conditions and the following disclaimer in the documentation 
   and/or other materials provided with the distribution.

THIS SOFTWARE IS PROVIDED BY THE COPYRIGHT HOLDERS AND CONTRIBUTORS "AS IS" 
AND ANY EXPRESS OR IMPLIED WARRANTIES, INCLUDING, BUT NOT LIMITED TO, 
THE IMPLIED WARRANTIES OF MERCHANTABILITY AND FITNESS FOR A PARTICULAR 
PURPOSE ARE DISCLAIMED. IN NO EVENT SHALL THE COPYRIGHT HOLDER OR CONTRIBUTORS 
BE LIABLE FOR ANY DIRECT, INDIRECT, INCIDENTAL, SPECIAL, EXEMPLARY, OR 
CONSEQUENTIAL DAMAGES (INCLUDING, BUT NOT LIMITED TO, PROCUREMENT OF SUBSTITUTE 
GOODS OR SERVICES; LOSS OF USE, DATA, OR PROFITS; OR BUSINESS INTERRUPTION) 
HOWEVER CAUSED AND ON ANY THEORY OF LIABILITY, WHETHER IN CONTRACT, STRICT 
LIABILITY, OR TORT (INCLUDING NEGLIGENCE OR OTHERWISE) ARISING IN ANY WAY OUT 
OF THE USE OF THIS SOFTWARE, EVEN IF ADVISED OF THE POSSIBILITY OF SUCH DAMAGE.

//////////////////////////////////////////////////////////// */

#include <stdio.h>
#include <ysclass.h>

static const char correctResult[]=
{
	"OOOOOOOOOOOOOOOOOOOOOOOOOOOOOOOOOOOOOOOOOOOOOOOOOOOOOOOOOOOOOOOOOOOOOOOOOOO"
	"OOOOOOOOOOOOOOOOOOOOOOOOOOOOOOOOOOOOOOOOOOOOOOOOOOOOOOOOOOOOOOOOOOOOOOOOOOO"
	"OOOOOOOOOOOOOOOOOOOOOOOOOOOOOOOOOOOOOOOOOOOOOOOOOOOOOOOOOOOOOOOOOOOOOOOOOOO"
	"OOOOOOOOOOOOOOOOOOOOOOOOOOOOOOOOOOOOOOOOOOOOOOOOOOOOOOOOOOOOOOOOOOOOOOOOOOO"
	"OOOOOOOOOOOOOOOOOOOOOOOOOOOOOOOOOOOOOOOOOOOOOOOOOOOOOOOOOOOOOOOOOOOOOOOOOOO"
	"OOOOOOOOOOOOOOOOOOOOOOOOOOOOOOOOOOOOOOOOBOOOOOOOOOOOOOOOOOOOOOOOOOOOOOOOOOO"
	"OOOOOOOOOOOOOOOOOOOOOOOOOOOOOOOOOOBIIIIIIIBOOOOOOOOOOOOOOOOOOOOOOOOOOOOOOOO"
	"OOOOOOOOOOOOOOOOOOOOOOOOOOOOBIIIIIIIIIIIIIIIBOOOOOOOOOOOOOOOOOOOOOOOOOOOOOO"
	"OOOOOOOOOOOOOOOOOOOOOOBIIIIIIIIIIIIIIIIIIIIIIIBOOOOOOOOOOOOOOOOOOOOOOOOOOOO"
	"OOOOOOOOOOOOOOOOBIIIIIIIIIIIIIIIIIIIIIIIIIIIIIIIBOOOOOOOOOOOOOOOOOOOOOOOOOO"
	"OOOOOOOOOOBIIIIIIIIIIIIIIIIIIIIIIIIIIIIIIIIIIIIIIIBOOOOOOOOOOOOOOOOOOOOOOOO"
	"OOOOOOOOOOBIIIIIIIIIIIIIIIIIIIIIIIIIIIIIIIIIIIIIIIIIBOOOOOOOOOOOOOOOOOOOOOO"
	"OOOOOOOOOOBIIIIIIIIIIIIIIIIIIIIIIIIIIIIIIIIIIIIIIIIIIIBOOOOOOOOOOOOOOOOOOOO"
	"OOOOOOOOOOBIIIIIIIIIIIIIIIIIIIIIIIIIIIIIIIIIIIIIIIIIIIIIBOOOOOOOOOOOOOOOOOO"
	"OOOOOOOOOOBIIIIIIIIIIIIIIIIIIIIIIIIIIIIIIIIIIIIIIIIIIIIIIIBOOOOOOOOOOOOOOOO"
	"OOOOOOOOOOBIIIIIIIIIIIIIIIIIIIIIIIIIIIIIIIIIIIIIIIIIIIIIIIIIBOOOOOOOOOOOOOO"
	"OOOOOOOOOOBIIIIIIIIIIIIIIIIIIIIIIIIIIIIIIIIIIIIIIIIIIIIIIIBOOOOOOOOOOOOOOOO"
	"OOOOOOOOOOOOOOOOOOOOBIIIIIIIIIIIIIIIIIIIIIIIIIIIIIIIIIIIBOOOOOOOOOOOOOOOOOO"
	"OOOOOOOOOOOOOOOOOOOOOOOOOOOOOOBIIIIIIIIIIIIIIIIIIIIIIIBOOOOOOOOOOOOOOOOOOOO"
	"OOOOOOOOOOOOOOOOOOOOOOOOOOOOOOOOOOOOOOOOBIIIIIIIIIIIBOOOOOOOOOOOOOOOOOOOOOO"
	"OOOOOOOOOOOOOOOOOOOOOOOOOOOOOOOOOOOOOOOOOOOOOOOOOOBOOOOOOOOOOOOOOOOOOOOOOOO"
	"OOOOOOOOOOOOOOOOOOOOOOOOOOOOOOOOOOOOOOOOOOOOOOOOOOOOOOOOOOOOOOOOOOOOOOOOOOO"
	"OOOOOOOOOOOOOOOOOOOOOOOOOOOOOOOOOOOOOOOOOOOOOOOOOOOOOOOOOOOOOOOOOOOOOOOOOOO"
	"OOOOOOOOOOOOOOOOOOOOOOOOOOOOOOOOOOOOOOOOOOOOOOOOOOOOOOOOOOOOOOOOOOOOOOOOOOO"
};

const int nVtx=5;
double vtxTemplate[nVtx][2]=
{
	{10,10},{40,5},{60,15},{50,20},{10,16}
};


int main(void)
{
	printf("@@@ TESTING: YsCheckInsidePolygon2\n");

	YsVec2 vtx[nVtx];
	for(int i=0; i<nVtx; i++)
	{
		vtx[i].Set(vtxTemplate[i]);
	}

	for(int y=0; y<24; y++)
	{
		for(int x=0; x<75; x++)
		{
			YsVec2 poi;
			poi.Set((double)(x),(double)(y));  // Point of interest
			switch(YsCheckInsidePolygon2(poi,nVtx,vtx))
			{
			case YSINSIDE:
				printf("I");
				break;
			case YSOUTSIDE:
				printf("O");
				break;
			case YSBOUNDARY:
				printf("B");
				break;
			case YSUNKNOWNSIDE:
				printf("?");
				break;
			}
		}
		printf("\n");
	}



	printf("Verifying with the correct answer.\n");
	YSRESULT res=YSOK;
	int index=0;
	for(int y=0; y<24; y++)
	{
		for(int x=0; x<75; x++)
		{
			char c;
			YsVec2 poi((double)(x),(double)(y));  // Point of interest
			switch(YsCheckInsidePolygon2(poi,nVtx,vtx))
			{
			case YSINSIDE:
				c='I';
				break;
			case YSOUTSIDE:
				c='O';
				break;
			case YSBOUNDARY:
				c='B';
				break;
			case YSUNKNOWNSIDE:
				c='?';
				break;
			}

			if(correctResult[index]==c)
			{
				putchar(' ');
			}
			else
			{
				putchar('E');
				res=YSERR;
			}

			index++;
		}
		printf("\n");
	}

	if(YSOK==res)
	{
		printf("@@@ TEST RESULT: OK\n");
		return 0;
	}
	else
	{
		printf("@@@ TEST RESULT: ERROR\n");
		return 1;
	}
}
